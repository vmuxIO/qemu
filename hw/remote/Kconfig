## hw/remote/Kconfig
```kconfig
config MULTIPROCESS
    bool
    depends on PCI && PCI_EXPRESS && KVM
    select REMOTE_PCIHOST
config IOREGIONFD
    bool
    default n
    depends on MULTIPROCESS
```
